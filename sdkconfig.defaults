## sdkconfig.defaults
```kconfig
# ESP32 BalloonInteliPump SDK Config Defaults
CONFIG_IDF_TARGET="esp32"

# System Clock & FreeRTOS
CONFIG_ESP_DEFAULT_CPU_FREQ_MHZ_240=y
CONFIG_ESP32_DEFAULT_CPU_FREQ_240=y
CONFIG_FREERTOS_HZ=1000

# Task Watchdog
CONFIG_ESP_TASK_WDT_EN=y
CONFIG_ESP_TASK_WDT_TIMEOUT_S=5

# WiFi & LWIP Socket Performance
CONFIG_LWIP_MAX_SOCKETS=10
CONFIG_ESP_WIFI_STATIC_RX_BUFFER_NUM=10
CONFIG_ESP_WIFI_DYNAMIC_RX_BUFFER_NUM=32
```
